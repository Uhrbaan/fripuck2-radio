## sdkconfig.defaults
```kconfig
# ESP-IDF v5.x Modernized Defaults
CONFIG_IDF_TARGET="esp32"

# --- Partition Table ---
CONFIG_PARTITION_TABLE_SINGLE_APP=y
CONFIG_PARTITION_TABLE_FILENAME="partitions_singleapp.csv"
CONFIG_PARTITION_TABLE_MD5=y

# --- Compiler Options ---
CONFIG_COMPILER_OPTIMIZATION_DEBUG=y
CONFIG_COMPILER_OPTIMIZATION_ASSERTIONS_ENABLE=y
CONFIG_COMPILER_STACK_CHECK_MODE_ALL=y
CONFIG_COMPILER_STACK_CHECK=y
CONFIG_COMPILER_CXX_EXCEPTIONS=y

# --- Bootloader ---
# In v5, log levels use integers. 2 = WARN
CONFIG_BOOTLOADER_LOG_LEVEL=2
CONFIG_BOOTLOADER_VDDSDIO_BOOST_1_9V=y
CONFIG_BOOTLOADER_WDT_ENABLE=y
CONFIG_BOOTLOADER_WDT_TIME_MS=9000

# --- Serial Flasher & Monitor ---
# CONFIG_ESPTOOLPY_FLASHSIZE_2MB=y
CONFIG_ESPTOOLPY_FLASHSIZE_4MB=y
CONFIG_ESPTOOLPY_FLASHMODE_DIO=y
CONFIG_ESPTOOLPY_FLASHFREQ_40M=y
CONFIG_ESP_CONSOLE_UART_BAUDRATE=230400
CONFIG_ESPTOOLPY_MONITOR_BAUD=230400
CONFIG_MONITOR_BAUD=230400

# --- Bluetooth ---
CONFIG_BT_ENABLED=y
CONFIG_BT_CONTROLLER_ENABLED=y
CONFIG_BTDM_CTRL_MODE_BLE_ONLY=y
CONFIG_BTDM_CTRL_PINNED_TO_CORE=0
CONFIG_BTDM_CTRL_HCI_MODE_VHCI=y
CONFIG_BTDM_CTRL_MODEM_SLEEP=y
CONFIG_BT_BLUEDROID_ENABLED=y
CONFIG_BT_BLUEDROID_PINNED_TO_CORE=0
CONFIG_BT_BLE_ENABLED=y
CONFIG_BT_GATTS_ENABLE=y
CONFIG_BT_GATTC_ENABLE=y
# Trace levels in v5 are set individually per module, defaulting to warning (2) is usually fine.

# --- FreeRTOS ---
CONFIG_FREERTOS_HZ=1000
CONFIG_FREERTOS_CHECK_STACKOVERFLOW_CANARY=y
CONFIG_FREERTOS_INTERRUPT_BACKTRACE=y
CONFIG_FREERTOS_SUPPORT_STATIC_ALLOCATION=y
# "Assert on untested" and "Fail abort" are now largely handled by Compiler Optimization Assertion Level

# --- ESP32 Specific ---
CONFIG_ESP_DEFAULT_CPU_FREQ_MHZ_240=y
CONFIG_ESP_SYSTEM_PANIC_PRINT_HALT=y
CONFIG_ESP_INT_WDT=y
CONFIG_ESP_TASK_WDT_EN=y
CONFIG_ESP_TASK_WDT_TIMEOUT_S=5
CONFIG_ESP_BROWNOUT_DET=y
CONFIG_ESP_PHY_REDUCE_TX_POWER=y
CONFIG_ESP_PHY_CALIBRATION_AND_DATA_STORAGE=y

# --- Wi-Fi ---
CONFIG_ESP_WIFI_STATIC_RX_BUFFER_NUM=10
CONFIG_ESP_WIFI_DYNAMIC_RX_BUFFER_NUM=32
CONFIG_ESP_WIFI_DYNAMIC_TX_BUFFER=y
CONFIG_ESP_WIFI_TX_BUFFER_TYPE=1
CONFIG_ESP_WIFI_TASK_PINNED_TO_CORE_0=y

# --- Ethernet ---
# DMA configs moved to ETH component
CONFIG_ETH_DMA_BUFFER_SIZE=512
CONFIG_ETH_DMA_RX_BUFFER_NUM=10
CONFIG_ETH_DMA_TX_BUFFER_NUM=10

# --- LWIP ---
CONFIG_LWIP_SO_RCVBUF=y
CONFIG_LWIP_DHCP_DOES_ARP_CHECK=y
CONFIG_LWIP_ESP_GRATUITOUS_ARP=y

# --- MbedTLS ---
CONFIG_MBEDTLS_HARDWARE_AES=y
CONFIG_MBEDTLS_HAVE_TIME=y
CONFIG_MBEDTLS_TLS_ENABLED=y
CONFIG_MBEDTLS_SSL_PROTO_TLS1_2=y
# TLS 1.0/1.1 are disabled by default in v5 for security

# --- FATFS ---
CONFIG_FATFS_LFN_NONE=y
CONFIG_FATFS_CODEPAGE_437=y
CONFIG_FATFS_PER_FILE_CACHE=y

# --- HTTP Client ---
CONFIG_ESP_HTTP_CLIENT_ENABLE_HTTPS=y
```
